// SPDX-License-Identifier: GPL-2.0-or-later OR MIT

#include "mt7621_dlink_dir-8xx.dtsi"
#include "mt7621_dlink_flash-16m-a1.dtsi"

/ {
	compatible = "motorola,motorola-mr2600", "mediatek,mt7621-soc";
	model = "Motorola MR2600";
};

&leds {
	usb3 {
		label = "green:usb3";
		gpios = <&gpio 14 GPIO_ACTIVE_LOW>;
		trigger-sources = <&xhci_ehci_port1>;
		linux,default-trigger = "usbport";
	};
};